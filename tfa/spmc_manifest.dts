/*
 * SPMC Manifest for our hypervisor running as BL32 at S-EL2.
 *
 * Passed to SPMC via x0 (TOS_FW_CONFIG) by SPMD at EL3.
 * Format: FF-A Core Manifest v1.0 (DEN0077A).
 *
 * This manifest describes our SPMC's properties to the SPMD.
 * Initially used with the trivial BL32 hello payload; will be
 * updated for the real hypervisor SPMC in Sprint 4.3.
 */

/dts-v1/;

/ {
    compatible = "arm,ffa-core-manifest-1.0";
    #address-cells = <2>;
    #size-cells = <2>;

    attribute {
        spmc_id = <0x8000>;             /* FF-A SPMC partition ID */
        maj_ver = <0x1>;                /* FF-A major version 1 */
        min_ver = <0x1>;                /* FF-A minor version 1 */
        exec_state = <0x0>;             /* AArch64 */
        load_address = <0x0 0x0e100000>;/* SEC_DRAM_BASE */
        entrypoint = <0x0 0x0e100000>;  /* Cold boot entry point */
        binary_size = <0x0 0x80000>;    /* 512KB (sufficient for trivial) */
    };
};
